/**
 * @file a277d-led-tachometer.ino
 * @brief Arduino program to generate a square wave with adjustable frequency to control an A277D LED driver chip.
 * 
 * This program outputs a square wave on Pin 3 with a default frequency of 60 Hz.
 * A pushbutton connected to Pin 4 allows the user to gradually increase the frequency
 * up to 200 Hz when pressed, and decrease it back to 60 Hz when released.
 * The frequency changes smoothly at a rate defined by FREQ_CHANGE_SPEED.
 * 
 * @note This program uses `digitalWrite` and `micros` for precise timing and frequency adjustments.
 * 
 * @author Balazs Markus
 */

// Define constants
#define SQUARE_WAVE_PIN 3
#define BUTTON_PIN 4
#define MIN_FREQ 60
#define MAX_FREQ 200
#define FREQ_CHANGE_SPEED 200 // Frequency change step in Hz per second

// Variables to keep track of the current frequency and state
int currentFreq = MIN_FREQ;
bool buttonState = LOW;
bool lastButtonState = LOW;
unsigned long lastChangeTime = 0;
unsigned long halfPeriod = 1000000 / (MIN_FREQ * 2); // initial half-period in microseconds
unsigned long lastToggleTime = 0;

/**
 * @brief Initializes the square wave pin and button pin.
 * 
 * This function sets up the square wave pin as an output and the button pin as an input
 * with an internal pull-up resistor.
 */
void setup() {
  pinMode(SQUARE_WAVE_PIN, OUTPUT);
  pinMode(BUTTON_PIN, INPUT_PULLUP); // Use the internal pull-up resistor
}

/**
 * @brief Main loop to generate the square wave and adjust its frequency.
 * 
 * This function reads the button state and adjusts the frequency of the square wave accordingly.
 * If the button is pressed, the frequency increases until it reaches MAX_FREQ.
 * If the button is released, the frequency decreases until it reaches MIN_FREQ.
 * The square wave is generated by toggling the pin state at intervals defined by the current frequency.
 */
void loop() {
  buttonState = digitalRead(BUTTON_PIN);

  // Check for button press and release
  if (buttonState == LOW && currentFreq < MAX_FREQ) {
    // Button pressed, increase frequency
    unsigned long currentTime = micros();
    if (currentTime - lastChangeTime >= 1000000 / FREQ_CHANGE_SPEED) {
      currentFreq++;
      lastChangeTime = currentTime;
      halfPeriod = 1000000 / (currentFreq * 2);
    }
  } else if (buttonState == HIGH && currentFreq > MIN_FREQ) {
    // Button released, decrease frequency
    unsigned long currentTime = micros();
    if (currentTime - lastChangeTime >= 1000000 / FREQ_CHANGE_SPEED) {
      currentFreq--;
      lastChangeTime = currentTime;
      halfPeriod = 1000000 / (currentFreq * 2);
    }
  }

  // Generate square wave
  unsigned long currentMicros = micros();
  if (currentMicros - lastToggleTime >= halfPeriod) {
    lastToggleTime = currentMicros;
    digitalWrite(SQUARE_WAVE_PIN, !digitalRead(SQUARE_WAVE_PIN));
  }
}
